/*
 * Advantech. mipi_tv080
 *
 */
/ {
	disp_timings: display-timings {
		mipi_tv080wxm: mipi-tv080wxm {
			clock-frequency = <68430000>;
			hactive = <800>;
			vactive = <1280>;
			hback-porch = <48>;
			hfront-porch = <16>;
			vback-porch = <4>;
			vfront-porch = <8>;
			hsync-len = <16>;
			vsync-len = <4>;
			hsync-active = <1>;
			vsync-active = <1>;
			de-active = <0>;
			pixelclk-active = <0>;
			panel-init-sequence = [
				29 64 02 E0 00  
				29 00 02 E1 93 
				29 00 02 E2 65 
				29 00 02 E3 F8 
				29 00 02 80 03 
				29 00 02 78 93 
				29 00 02 79 66 
				29 00 02 7A FF 
				29 00 02 7B FF 
				29 00 02 E0 01 
				29 00 02 00 00 
				29 00 02 01 B0 
				29 00 02 03 00 
				29 00 02 04 B0 
				29 00 02 17 00 
				29 00 02 18 B1 
				29 00 02 19 01 
				29 00 02 1A 00 
				29 00 02 1B B1 
				29 00 02 1C 01 
				29 00 02 1F 3E 
				29 00 02 20 28 
				29 00 02 21 28 
				29 00 02 22 0E 
				29 00 02 37 19 
				29 00 02 38 05 
				29 00 02 39 08 
				29 00 02 3A 12 
				29 00 02 3C 78 
				29 00 02 3D FF 
				29 00 02 3E FF 
				29 00 02 3F FF 
				29 00 02 40 06 
				29 00 02 41 A0 
				29 00 02 43 08 
				29 00 02 44 07 
				29 00 02 45 40 
				29 00 02 4B 04 
				29 00 02 55 00 
				29 00 02 56 01 
				29 00 02 57 89 
				29 00 02 58 0A 
				29 00 02 59 0A 
				29 00 02 5A 28 
				29 00 02 5B 14 

				29 00 02 5D 7C 
				29 00 02 5E 66 
				29 00 02 5F 57 
				29 00 02 60 49 
				29 00 02 61 46 
				29 00 02 62 36 
				29 00 02 63 3A 
				29 00 02 64 23 
				29 00 02 65 3C 
				29 00 02 66 38 
				29 00 02 67 37 
				29 00 02 68 53 
				29 00 02 69 40 
				29 00 02 6A 47 
				29 00 02 6B 38 
				29 00 02 6C 31 
				29 00 02 6D 22 
				29 00 02 6E 11 
				29 00 02 6F 00 
				29 00 02 70 7C 
				29 00 02 71 66 
				29 00 02 72 57 
				29 00 02 73 49 
				29 00 02 74 46 
				29 00 02 75 36 
				29 00 02 76 3A 
				29 00 02 77 23 
				29 00 02 78 3C 
				29 00 02 79 38 
				29 00 02 7A 37 
				29 00 02 7B 53 
				29 00 02 7C 40 
				29 00 02 7D 47 
				29 00 02 7E 38 
				29 00 02 7F 31 
				29 00 02 80 22 
				29 00 02 81 11 
				29 00 02 82 00 
				29 00 02 E0 02 
				29 00 02 00 47 
				29 00 02 01 47 
				29 00 02 02 45 
				29 00 02 03 45 
				29 00 02 04 4B 
				29 00 02 05 4B 
				29 00 02 06 49 
				29 00 02 07 49 
				29 00 02 08 41 
				29 00 02 09 1F 
				29 00 02 0A 1F 
				29 00 02 0B 1F 
				29 00 02 0C 1F 
				29 00 02 0D 1F 
				29 00 02 0E 1F 
				29 00 02 0F 43 
				29 00 02 10 1F 
				29 00 02 11 1F 
				29 00 02 12 1F 
				29 00 02 13 1F 
				29 00 02 14 1F 
				29 00 02 15 1F 
				29 00 02 16 46 
				29 00 02 17 46 
				29 00 02 18 44 
				29 00 02 19 44 
				29 00 02 1A 4A 
				29 00 02 1B 4A 
				29 00 02 1C 48 
				29 00 02 1D 48 
				29 00 02 1E 40 
				29 00 02 1F 1F 
				29 00 02 20 1F 
				29 00 02 21 1F 
				29 00 02 22 1F 
				29 00 02 23 1F 
				29 00 02 24 1F 
				29 00 02 25 42 
				29 00 02 26 1F 
				29 00 02 27 1F 
				29 00 02 28 1F 
				29 00 02 29 1F 
				29 00 02 2A 1F 
				29 00 02 2B 1F 
				29 00 02 2C 11 
				29 00 02 2D 0F 
				29 00 02 2E 0D 
				29 00 02 2F 0B 
				29 00 02 30 09 
				29 00 02 31 07 
				29 00 02 32 05 
				29 00 02 33 18 
				29 00 02 34 17 
				29 00 02 35 1F 
				29 00 02 36 01 
				29 00 02 37 1F 
				29 00 02 38 1F 
				29 00 02 39 1F 
				29 00 02 3A 1F 
				29 00 02 3B 1F 
				29 00 02 3C 1F 
				29 00 02 3D 1F 
				29 00 02 3E 1F 
				29 00 02 3F 13 
				29 00 02 40 1F 
				29 00 02 41 1F 
				29 00 02 42 10 
				29 00 02 43 0E 
				29 00 02 44 0C 
				29 00 02 45 0A 
				29 00 02 46 08 
				29 00 02 47 06 
				29 00 02 48 04 
				29 00 02 49 18 
				29 00 02 4A 17 
				29 00 02 4B 1F 
				29 00 02 4C 00 
				29 00 02 4D 1F 
				29 00 02 4E 1F 
				29 00 02 4F 1F 
				29 00 02 50 1F 
				29 00 02 51 1F 
				29 00 02 52 1F 
				29 00 02 53 1F 
				29 00 02 54 1F 
				29 00 02 55 12 
				29 00 02 56 1F 
				29 00 02 57 1F 
				29 00 02 58 40 
				29 00 02 5B 30 
				29 00 02 5C 02 
				29 00 02 5D 40 
				29 00 02 5E 01 
				29 00 02 5F 02 
				29 00 02 63 62 
				29 00 02 64 62 
				29 00 02 67 74 
				29 00 02 68 04 
				29 00 02 69 62 
				29 00 02 6A 66 
				29 00 02 6B 08 
				29 00 02 6C 00 
				29 00 02 6D 00 
				29 00 02 6E 00 
				29 00 02 6F 08 
				29 00 02 E0 03 
				29 00 02 98 3E 
				29 00 02 E0 04 
				29 00 02 09 14 
				29 00 02 2B 2B 
				29 00 02 2E 44 
				29 00 02 E0 00 
				29 00 02 E6 02 
				29 00 02 E7 06 
				29 00 02 E0 03 
				29 00 02 9B 04 
				29 00 02 E0 00 
				29 00 01 11
				29 78 01 29   
				29 09 02 35 00 
			];
		};
	};
};
