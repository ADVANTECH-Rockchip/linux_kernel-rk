/*
 * Advantech. LCD_G150XGE-L05 ver 2.0  1024 x 768
 *
 */
/ {
	disp_timings: display-timings {
		lvds_am1024600k2tmqw: lvds-am1024600k2tmqw {
			lvds-format = <LVDS_8BIT_1>;
			clock-frequency = <52000000>;
			hactive = <1024>;
			vactive = <600>;
			hback-porch = <10>;
			hfront-porch = <300>;
			vback-porch = <4>;
			vfront-porch = <27>;
			hsync-len = <10>;
			vsync-len = <4>;
			hsync-active = <0>;
			vsync-active = <0>;
			de-active = <0>;
			pixelclk-active = <0>;
			panel-init-sequence = [
				29 00 06 3C 01 03 00 02 00
				29 00 06 14 01 02 00 00 00
				29 00 06 64 01 02 00 00 00
				29 00 06 68 01 02 00 00 00
				29 00 06 6C 01 02 00 00 00
				29 00 06 70 01 02 00 00 00
				29 00 06 34 01 1F 00 00 00
				29 00 06 10 02 1F 00 00 00
				29 00 06 04 01 01 00 00 00
				29 00 06 04 02 01 00 00 00
				29 00 06 50 04 20 01 F0 03
				29 00 06 54 04 0A 00 0A 00
				29 00 06 58 04 00 04 2C 01
				29 00 06 5C 04 04 00 04 00
				29 00 06 60 04 58 02 1B 00
				29 00 06 64 04 01 00 00 00
				29 01 06 A0 04 2D 80 44 00
				29 00 06 A0 04 2D 80 04 00
				29 00 06 04 05 04 00 00 00
				29 00 06 80 04 02 03 04 05
				29 00 06 84 04 06 01 07 0A
				29 00 06 88 04 0E 0C 08 09
				29 00 06 8C 04 0D 0E 0F 12
				29 00 06 90 04 10 11 13 14
				29 00 06 94 04 15 16 17 1B
				29 14 06 98 04 18 19 1A 00
				29 78 06 9C 04 31 00 00 00
			];
		};
	};
};
